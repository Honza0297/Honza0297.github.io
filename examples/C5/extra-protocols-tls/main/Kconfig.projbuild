## examples/C5/extra-protocols-tls/main/Kconfig.projbuild
```kconfig
menu "Workshop example: Wi-Fi"
    config EXAMPLE_ESP_WIFI_SSID
        string "WiFi SSID"
        default "myssid"
        help
            SSID (network name) for the example to connect to.

    config EXAMPLE_ESP_WIFI_PASSWORD
        string "WiFi password"
        default "mypassword"
        help
            WiFi password (WPA or WPA2) for the example to use.
endmenu
```
